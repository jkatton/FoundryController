#pragma once
#include <Arduino.h>
#include <pgmspace.h>

// Char-o-matic wordmark logo, antialiased, cropped tight to the inked
// content (2px pad) rather than the full logical canvas - the original
// 190x128 canvas had a lot of plain COL_BG margin around the wordmark
// that cost flash for no visual benefit, since it is drawn opaque over
// an already-COL_BG screen anyway (see Display::showLogo()).
//
// Stored compressed (lossless) to save flash: 3767 bytes instead of the
// 24624 bytes the raw RGB565 bitmap took. The wordmark is pure
// grayscale (white on black, antialiased), so every pixel is one of 64
// gray levels, and the pixels are run-length encoded in row-major order
// (runs may continue across row boundaries). Each token is one byte:
//
//     bits 7..6  run length code: 0, 1, 2 -> a run of 1, 2 or 3 pixels
//                                 3       -> a longer run: length is 4 plus
//                                            the sum of the bytes that follow,
//                                            up to and including the first
//                                            byte that is not 255
//     bits 5..0  gray level v (0..63)
//
// and a gray level v expands to the RGB565 color ((v>>1)<<11)|(v<<5)|(v>>1)
// (i.e. red = blue = v/2, green = v) - exactly the colors the original
// bitmap used. Decode with the helpers below: charOMaticLogoBegin() then
// charOMaticLogoRead() for as many pixels as you want at a time (a row at a
// time keeps RAM use to one small row buffer).
#define CHAR_O_MATIC_LOGO_W 162
#define CHAR_O_MATIC_LOGO_H 76
static const uint8_t CHAR_O_MATIC_LOGO_RLE[] PROGMEM = {
  0xC0,0xFF,0x8E,0x06,0x04,0xC0,0x9C,0x21,0x1B,0xC0,0x9C,0x38,0x31,0xC0,0x9C,0x7F,
  0xC0,0x9B,0x28,0x2F,0x35,0x20,0xC0,0x99,0x0B,0x3F,0x00,0x06,0x3F,0x02,0xC0,0x97,
  0x10,0x3F,0x0F,0x40,0x1A,0x3F,0x0B,0xC0,0x96,0x16,0x3F,0x0F,0x40,0x1A,0x3F,0x0E,
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  0x06,0xC0,0x03,0x18,0xC0,0xFF,0x49,
};

struct CharOMaticLogoDecoder {
  const uint8_t *p;     // next token to read (PROGMEM)
  uint16_t remaining;   // pixels left in the current run
  uint16_t color;       // the current run's RGB565 color
};

static inline void charOMaticLogoBegin(CharOMaticLogoDecoder &d) {
  d.p = CHAR_O_MATIC_LOGO_RLE;
  d.remaining = 0;
  d.color = 0;
}

// Writes the next `count` pixels of the logo (row-major) into dst as RGB565.
static inline void charOMaticLogoRead(CharOMaticLogoDecoder &d, uint16_t *dst, int count) {
  while (count > 0) {
    if (d.remaining == 0) {
      uint8_t b = pgm_read_byte(d.p++);
      uint8_t v = b & 0x3F;
      d.color = (uint16_t)(((uint16_t)(v >> 1) << 11) | ((uint16_t)v << 5) | (uint16_t)(v >> 1));
      uint8_t code = b >> 6;
      if (code < 3) {
        d.remaining = code + 1;
      } else {
        uint16_t len = 4;
        uint8_t extra;
        do {
          extra = pgm_read_byte(d.p++);
          len += extra;
        } while (extra == 255);
        d.remaining = len;
      }
    }
    uint16_t n = (d.remaining < (uint16_t)count) ? d.remaining : (uint16_t)count;
    for (uint16_t i = 0; i < n; i++) dst[i] = d.color;
    dst += n;
    count -= n;
    d.remaining -= n;
  }
}